## meta-nogplv3/conf/layer.conf
```bitbake
# We have a conf and classes directory, add to BBPATH
BBPATH .= ":${LAYERDIR}"

# We have recipes-* directories, add to BBFILES
BBFILES += "${LAYERDIR}/recipes-*/*/*.bb \
            ${LAYERDIR}/recipes-*/*/*.bbappend \
            ${LAYERDIR}/dynamic-layers/*/*/*/*.bb \
            ${LAYERDIR}/dynamic-layers/*/*/*/*.bbappend"

BBFILES_DYNAMIC += " \
    meta-selinux:${LAYERDIR}/dynamic-layers/meta-selinux/recipes-security/selinux/*.bbappend \
    meta-selinux:${LAYERDIR}/dynamic-layers/meta-selinux/recipes-platform/packagegroups/*.bbappend \
    "

BBFILE_COLLECTIONS += "nogplv3"
BBFILE_PATTERN_nogplv3 = "^${LAYERDIR}/"
BBFILE_PRIORITY_nogplv3 = "10"

LAYERDEPENDS_nogplv3 = "aglcore"
LAYERSERIES_COMPAT_nogplv3 = "scarthgap"
```
